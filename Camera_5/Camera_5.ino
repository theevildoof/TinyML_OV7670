/*
  OV767X - Camera Test Pattern

  This sketch waits for the letter 'c' on the Serial Monitor,
  it then reads a frame from the OmniVision OV7670 camera and 
  prints the data to the Serial Monitor as a hex string.

  The website https://rawpixels.net - can be used the visualize the data:
    width: 176
    height: 144
    RGB565
    Little Endian

  Circuit:
    - Arduino Nano 33 BLE board
    - OV7670 camera module:
      - 3.3 connected to 3.3
      - GND connected GND
      - SIOC connected to A5
      - SIOD connected to A4
      - VSYNC connected to 8
      - HREF connected to A1
      - PCLK connected to A0
      - XCLK connected to 9
      - D7 connected to 4
      - D6 connected to 6
      - D5 connected to 5
      - D4 connected to 3
      - D3 connected to 2
      - D2 connected to 0 / RX
      - D1 connected to 1 / TX
      - D0 connected to 10

  This example code is in the public domain.
*/

#include <Arduino_OV767X.h>

uint16_t pixels[176 * 144]= {0x0D2A,0xED29,0xED29,0xED29,0xEC21,0xED29,0xED29,0xEC29,0xEC29,0x0D32,0xCC29,0xCC29,0xAC29,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0xCF6B,};
void setup() {
  Serial.begin(9600);
  while (!Serial);

  Serial.println("OV767X Camera Capture");
  Serial.println();

  if (!Camera.begin(QCIF, RGB565, 1)) {
    Serial.println("Failed to initialize camera!");
    while (1);
  }

  Serial.println("Camera settings:");
  Serial.print("\twidth = ");
  Serial.println(Camera.width());
  Serial.print("\theight = ");
  Serial.println(Camera.height());
  Serial.print("\tbits per pixel = ");
  Serial.println(Camera.bitsPerPixel());
  Serial.println();

  Serial.println("Send the 'c' character to read a frame ...");
  Serial.println();
}

void loop() {
  if (Serial.read() == 'c') {
    Serial.println("Reading frame");
    Serial.println();
    //Camera.readFrame(pixels);

    int numPixels = Camera.width() * Camera.height();

    for (int i = 0; i < 28; i++) {
      for(int j =0; j < 28; j++){
       uint16_t pixel = pixels[176*i +j];
       //Serial.println(pixel);
       //Serial.println(pixel,HEX);
       //RGB888 data
       int red   = ((pixel >> 11) & 0x1f) << 3;
       red += 50;
       int green = ((pixel >> 5) & 0x3f) << 2; 
       green += 50;
       int blue  = ((pixel >> 0) & 0x1f) << 3; 
       blue += 50;
       int grayscale = (red + green + blue)/3;
       //Serial.println(red);
       //Serial.println(green);
       //Serial.println(blue);
       Serial.print(grayscale);
       Serial.print(",");
        
       
        
      }
    }
  }
}
